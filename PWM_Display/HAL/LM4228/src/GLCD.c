/*
 * GLCD.c
 *
 * Created: 12/23/2022 11:36:08 PM
 *  Author: Abdallah Ayman 
 
 */ 
#include <stdarg.h>
#include <avr/pgmspace.h>
#include "GLCD.h"

GLCD_Config GLCD;

const Uint8 ARR_GlcdFont_U8[][7] PROGMEM= {
	{0xff,0xff,0xff,0xff,0xff,0x00,0xff}, /* 0x00  */
	{0xff,0xff,0xff,0xff,0xff,0x00,0xff},
	{0xff,0xff,0xff,0xff,0xff,0x00,0xff},
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	{0xff,0xff,0xff,0xff,0xff,0x00,0xff}, /*  0x80 */
};

/*************************************************************************************************
                                Local Static Functions
*************************************************************************************************/
static void glcd_CmdWrite( Uint8 var_lcdCmd_u8);
static void glcd_DataWrite( Uint8 var_data_u8);
static void glcd_BusyCheck();
static void glcd_SelectPage0();
static void glcd_SelectPage1();
/************************************************************************************************/


/************************************************************************************************/
static void glcd_CmdWrite( Uint8 var_cmd_u8)
{
	//glcd_BusyCheck();
	M_GlcdDataBus = var_cmd_u8;
	M_GlcdClearBit(GLCD_RS);           // Select the Command Register by pulling RS LOW
	
	M_GlcdClearBit(GLCD_RW);           // Select the Write Operation  by pulling RW LOW
	
	M_GlcdSetBit(GLCD_EN);             // Send a High-to-Low Pulse at Enable Pin
	_delay_us(2);
	M_GlcdClearBit(GLCD_EN);
	_delay_us(2);
	_delay_us(10);
}
/************************************************************************************************/
/************************************************************************************************/
static void glcd_DataWrite( Uint8 var_data_u8)
{
	//glcd_BusyCheck();
	M_GlcdDataBus = var_data_u8 ^ GLCD.Invertdisplay;
	M_GlcdSetBit(GLCD_RS);           // Select the Data Register by pulling RS High
	
	M_GlcdClearBit(GLCD_RW);           // Select the Write Operation  by pulling RW LOW
	M_GlcdSetBit(GLCD_EN);             // Send a High-to-Low Pulse at Enable Pin
	_delay_us(2);
	M_GlcdClearBit(GLCD_EN);
	_delay_us(2);
	_delay_us(10);
}
/************************************************************************************************/
/************************************************************************************************/
//static void glcd_BusyCheck()
//{
//    Uint8 busyflag;
//    
//#ifdef GLCD_RW                    //Perform Busy check if GLCD_RW pin is used
//
//    util_UpdateBit(M_GlcdDataBusDirection,GLCD_D7,C_PinInput); // Configure busy pin as input
//	
//    M_GlcdClearBit(GLCD_RS);           // Select the Command Register by pulling RS LOW
//    M_GlcdSetBit(GLCD_RW);             // Select the Read Operation for busy flag by setting RW
//    do
//    {
//        M_GlcdClearBit(GLCD_EN);             // Send a High-to-Low Pulse at Enable Pin
//        _delay_us(2);    
//        M_GlcdSetBit(GLCD_EN);
//        _delay_us(2);
//        busyflag = util_GetBitStatus(M_GlcdDataBusInput,GLCD_D7);
//    }while(busyflag);
//
//    util_UpdateBit(M_GlcdDataBusDirection,GLCD_D7,C_PinOutput);
//	
//#else
//    /* Busy flag cannot be read as GLCD_RW is not available hence Extra delay of 1ms is added 
//      to ensure the LCD completes previous operation and ready to receive new commands/data */
//    _delay_ms(1);  
//#endif
//}
/************************************************************************************************/
/************************************************************************************************/
static void glcd_SelectPage0()
{
	M_GlcdSetBit(GLCD_CS1);
	M_GlcdClearBit(GLCD_CS2);
}
/************************************************************************************************/
/************************************************************************************************/
static void glcd_SelectPage1()
{
	M_GlcdSetBit(GLCD_CS2);
	M_GlcdClearBit(GLCD_CS1);
}
/************************************************************************************************/
/************************************************************************************************/
void GLCD_Init()
{
	M_GlcdControlBusDirection = C_PortOutput; /* Configure the data bus and Control bus as Output */
	
	M_GlcdDataBusDirection = C_PortOutput;
	
	M_GlcdSetBit(GLCD_RST);
	_delay_us(100);
	M_GlcdClearBit(GLCD_RST);
	_delay_us(20);
	M_GlcdSetBit(GLCD_RST);
	_delay_us(100);

	/* Select the Page0/Page1 and Enable the GLCD */
	glcd_SelectPage0();
	glcd_CmdWrite(0x3F);
	glcd_SelectPage1();
	glcd_CmdWrite(0x3F);
	_delay_ms(10);

	/* Select the Page0/Page1 and Enable the GLCD */
	glcd_SelectPage0();
	glcd_CmdWrite(0xC0);
	glcd_SelectPage1();
	glcd_CmdWrite(0xC0);

	/* Clear the complete LCD and move the cursor to beginning of page0*/
	GLCD_Clear();
}
void GLCD_Clear()
{
	Uint8 line,cursor,inversion;

	inversion = GLCD.Invertdisplay;
	GLCD.Invertdisplay = 0x00;
	
	for(line=0;line<8;line++)  /* loop through all the 8lines to clear the display */
	{
		GLCD_GoToLine(line);  /* Go to beginning of the specified line on page0 */
		
		for(cursor=0;cursor<128;cursor++) /* Clear all the 128 pixels of selected line */
		{
			if(cursor==64)  /* Has the cursor reached end of page0 */
			{
				GLCD_GoToPage(1); /*  then set it to beginning of page1 */
				
			}
			glcd_DataWrite(0x00); /* Clear each pixel by displaying blank */
			
		}
	}
	
	GLCD.Invertdisplay = inversion;

	GLCD_GoToLine(0);
}


void ClrScreen(void){
	Uint8 i,j;
	for (i=0;i<8;i++){
		glcd_SelectPage0();
		glcd_CmdWrite(0xB8|i);
		glcd_CmdWrite(0x40);
		glcd_SelectPage1();
		glcd_CmdWrite(0xB8|i);
		glcd_CmdWrite(0x40);
		for(j=0;j<128;j++){
			if(j<64){
				glcd_SelectPage1();
				glcd_DataWrite(0x00);
			}else{
				glcd_SelectPage0();
				glcd_DataWrite(0x00);
			}
		}
	}
}
void GLCD_SetCursor(Uint8 pageNumber,Uint8 lineNumber,Uint8 CursorPosition)
{
	if(    ((pageNumber == 0x00)   || (pageNumber == 0x01))
	&& ((lineNumber >=0x00)    && (lineNumber <= C_GlcdLastLine_U8))
	&& ((CursorPosition>=0x00) && (CursorPosition <= 63)) )
	{
		if(pageNumber==0x00)  /* Check for page number and set accordingly */
		{
			glcd_SelectPage0();
		}
		else
		{
			glcd_SelectPage1();
		}

		GLCD.PageNum = pageNumber; /* Keep the track of page selected */
		GLCD.LineNum=lineNumber | C_FirstLineNumberAddress_U8; /* Select the specified line number */
		GLCD.CursorPos=CursorPosition |0x40; /* Select the specified cursor position */
		glcd_CmdWrite(GLCD.CursorPos); /* Command the LCD to move to specified page,line,cursor*/
		glcd_CmdWrite(GLCD.LineNum);
	}
}
void GLCD_GetCursor(Uint8 *page_ptr,Uint8 *line_ptr,Uint8 *cursor_ptr)
{

	*page_ptr=GLCD.PageNum;
	*line_ptr=GLCD.LineNum;
	*cursor_ptr=GLCD.CursorPos;
}
void GLCD_GoToPage(Uint8 pageNumber)
{

    if((pageNumber==0) || (pageNumber ==1))
    { 
        if(pageNumber == 0)
        {

            glcd_SelectPage0();
        }
        else
        {
            glcd_SelectPage1();
        }
        GLCD.PageNum=pageNumber;
        GLCD.CursorPos=0x40;
        glcd_CmdWrite(GLCD.LineNum);
        glcd_CmdWrite(GLCD.CursorPos);
		
    }
}
void  GLCD_GoToLine(Uint8 var_lineNumber_u8)
{
    if(var_lineNumber_u8 <= C_GlcdLastLine_U8)
    {   /* If the line number is within range (0->7)
         then move it to specified line on page0 and keep track*/
        GLCD.LineNum = var_lineNumber_u8+C_FirstLineNumberAddress_U8;
        GLCD_GoToPage(0);
    }
}
void  GLCD_GoToNextLine()
{
    /*Increment the current line number.
      In case it exceeds the limit, roll it back to first line */
    GLCD.LineNum++;
    if(GLCD.LineNum > C_LastLineNumberAddress_U8)
      GLCD.LineNum = C_FirstLineNumberAddress_U8;
    GLCD_GoToPage(0); /* Finally move it to next line on page0 */
}
void GLCD_EnableDisplayInversion()
{
	GLCD.Invertdisplay = 0xff;
}
void GLCD_DisableDisplayInversion()
{
	GLCD.Invertdisplay = 0x00;
}
void GLCD_DisplayChar(Uint8 var_lcdData_u8)
{
    Uint8 dat,*ptr;


    if(((GLCD.PageNum == 0x01) && (GLCD.CursorPos>=0x7c)) || (var_lcdData_u8=='\n'))
    {
        /* If the cursor has reached to end of line on page1
        OR NewLine command is issued Then Move the cursor to next line */
        GLCD_GoToNextLine();
    }
       if(var_lcdData_u8!='\n') 
    {
        ptr= &ARR_GlcdFont_U8[var_lcdData_u8][0]; /* Get the address of the Character pattern */
        while(1)
        {
            if((GLCD.PageNum == 0x00) && (GLCD.CursorPos==0x80))
            {
                /* If the cursor has reached to end of line on page0
                     Then Move the cursor to Page1 */
                GLCD_GoToPage(1);
            }

            dat= pgm_read_byte(ptr++);/* Get the data to be displayed for LookUptable*/

            if(dat==0xff) /* Exit the loop if End of char is encountered */
                break;

            glcd_DataWrite(dat); /* Display the data and keep track of cursor */
            GLCD.CursorPos++;
        }
    }
}
void GLCD_DisplayString(int8 *ptr_stringPointer_u8)
{
	while((*ptr_stringPointer_u8)!=0)
	GLCD_DisplayChar(*ptr_stringPointer_u8++); // Loop through the string and display char by char
}

#if ((Enable_GLCD_DisplayDecimalNumber == 1) || (Enable_GLCD_DisplayFloatNumber == 1))
void GLCD_DisplayDecimalNumber(Uint16 var_DecNumber_u32, Uint8 var_numOfDigitsToDisplay_u8)
{
    Uint8 i=0,a[10];

    if(var_DecNumber_u32==0)
    {
        /* If the number is zero then update the array with the same for displaying */
        for(i=0;((i<var_numOfDigitsToDisplay_u8) && (i<C_GlcdMaxDigitsToDisplay_U8));i++)
            a[i] = 0x00;
    }
    else
    {
        for(i=0;i<var_numOfDigitsToDisplay_u8;i++)
        {
            /* Continue extracting the digits from right side
               till the Specified var_numOfDigitsToDisplay_u8 */
            if(var_DecNumber_u32!=0)
            {
                /* Extract the digits from the number till it becomes zero.
                First get the remainder and divide the number by 10 each time.
                If var_num_u32 = 123 then extracted remainder will be 3 and number will be 12.
                The process continues till it becomes zero or max digits reached*/
                a[i]=util_GetMod32(var_DecNumber_u32,10);
                var_DecNumber_u32=var_DecNumber_u32/10;
            }
            else if( (var_numOfDigitsToDisplay_u8 == C_GlcdDisplayDefaultDigits_U8) ||
                     (var_numOfDigitsToDisplay_u8 > C_GlcdMaxDigitsToDisplay_U8))
            {
                /* Stop the iteration if the Max number of digits are reached or 
                 the user expects exact(Default) digits in the number to be displayed */ 
                break;
            }
            else
            {
                /* In case user expects more digits to be displayed than the actual digits in number,
                  then update the remaining digits with zero.
               Ex: var_num_u32 is 123 and user wants five digits then 00123 has to be displayed */
                a[i]=0;
            }
        }
    }


    while(i)
    { 
        /* Finally get the ascii values of the digits and display*/
        GLCD_DisplayChar(util_Dec2Ascii(a[i-1]));
        i--;
    }
}
#endif